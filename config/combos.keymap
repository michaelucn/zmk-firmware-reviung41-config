/*
 * Copyright (c) 2020 The ZMK Contributors
 *
 * SPDX-License-Identifier: MIT
 */

#include <behaviors.dtsi>
#include <dt-bindings/zmk/keys.h>

#define MORPH(NAME, BINDING_0, BINDING_1)\
        morph_##NAME: morph_##NAME {\
                compatible = "zmk,behavior-mod-morph";\
                #binding-cells = <0>;\
                bindings = <##BINDING_0>, <##BINDING_1>;\
                mods = <(MOD_LSFT|MOD_RSFT)>;\
        };

#define COMBO(NAME, KEY, KEY_POS)\
        combo_##NAME {\
                key-positions = ##KEY_POS;\
                layers = <0>;\
                bindings = <##KEY>;\
        };

&caps_word {
        continue-list = <UNDERSCORE MINUS>;
};

/ {
        behaviors {
                MORPH(paren_angle_l, &kp LEFT_PARENTHESIS, &kp LESS_THAN)
                MORPH(paren_angle_r, &kp RIGHT_PARENTHESIS, &kp GREATER_THAN)

                MORPH(star_percent, &kp STAR, &kp PERCENT)
                MORPH(slash, &kp SLASH, &kp BACKSLASH)
        };
};

/ {
        combos {
                compatible = "zmk,combos";

                COMBO(caps_lock, &caps_word, <16 19>)
                COMBO(caps_word, &kp CAPSLOCK, <15 20>)

                COMBO(escape, &kp ESC, <14 15 16>)
                COMBO(enter, &kp ENTER, <19 20 21>)

                COMBO(paren_l, &morph_paren_angle_l, <15 16>)
                COMBO(paren_r, &morph_paren_angle_r, <19 20>)

                COMBO(bracket_l, &kp LEFT_BRACKET, <27 28>)
                COMBO(bracket_r, &kp RIGHT_BRACKET, <31 32>)

                COMBO(star_percent, &morph_star_percent, <3 16>)
                COMBO(slash, &morph_slash, <19 8>)

                COMBO(minus, &kp MINUS, <14 15>)
                COMBO(equal, &kp EQUAL, <20 21>)

                COMBO(pipe, &kp PIPE, <3 4>)
                COMBO(hash, &kp HASH, <7 8>)

                COMBO(ampersand, &kp AMPERSAND, <2 3>)
                COMBO(dollar, &kp DOLLAR, <8 9>)

                COMBO(grave_tilde, &kp GRAVE, <26 27>)
        };
};
