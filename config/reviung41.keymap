/*
 * Copyright (c) 2020 The ZMK Contributors
 *
 * SPDX-License-Identifier: MIT
 */

#include <behaviors.dtsi>
#include <input/processors.dtsi>
#include <dt-bindings/zmk/keys.h>
#include <dt-bindings/zmk/bt.h>
#include <dt-bindings/zmk/ext_power.h>
#include <dt-bindings/zmk/outputs.h>
#include <dt-bindings/zmk/pointing.h>

#include "helpers.h"
#include "behaviors.dtsi"

// MACROS
// I'll remove this comment later
#define ALPHA 0
#define NAV 1
#define MOUSE 2
#define NUM 3
#define FUNC 4

// COMBOS
COMBO(caps_lock, &caps_word, 16 19, 0)
COMBO(caps_word, &kp CAPSLOCK, 15 20, 0)

COMBO(escape, &kp ESC, 14 15 16, 0)
COMBO(enter, &kp ENTER, 19 20 21, 0)

COMBO(paren_l, &paren_angle_l, 15 16, 0)
COMBO(paren_r, &paren_angle_r, 19 20, 0)

COMBO(bracket_l, &kp LEFT_BRACKET, 27 28, 0)
COMBO(bracket_r, &kp RIGHT_BRACKET, 31 32, 0)

COMBO(star_percent, &star_percent, 3 16, 0)
COMBO(slash, &slash, 19 8, 0)

COMBO(minus, &kp MINUS, 14 15, 0)
COMBO(equal, &kp EQUAL, 20 21, 0)

COMBO(pipe, &kp PIPE, 3 4, 0)
COMBO(hash, &kp HASH, 7 8, 0)

COMBO(ampersand, &kp AMPERSAND, 2 3, 0)
COMBO(dollar, &kp DOLLAR, 8 9, 0)

COMBO(grave_tilde, &kp GRAVE, 26 27, 0)

// LAYERS
LAYER(Base,
    &none  &kp F   &kp P          &kp D         &kp L            &kp X        &kp Q        &kp O               &kp U         &kp Y          &kp B  &none
    &none  &kp S   &hrml LCTRL N  &hrml LGUI T  &hrmls LSHIFT H  &kp K        &kp SEMI     &hrmrs LSHIFT A     &hrmr LGUI E  &hrmr LCTRL I  &kp C  &none
    &none  &marks  &kp W          &kp G         &hrml LALT M     &kp J        &key_repeat  &hrmr_stops LALT 0  &kp Z         &kp SQT        &kp V  &none

                                        &mo MOUSE  &lt NAV R  &kp TAB  &lt NUM SPACE  &mo FUNC
)

LAYER(Nav,
    &none  &kp C_MUTE    &kp C_PREV    &kp C_PP      &kp C_NEXT  &kp C_STOP        &msc SCRL_UP    &kp BSPC        &ht PG_UP UP    &kp DEL          &kp TAB    &none
    &none  &kp C_BRI_UP  &kp LCTRL     &kp LGUI      &kp LSHFT   &none             &msc SCRL_DOWN  &ht HOME LEFT   &ht PG_DN DOWN  &ht END RIGHT    &kp PSCRN  &none
    &none  &kp C_BRI_DN  &kp C_VOL_DN  &kp C_VOL_UP  &kp LALT    &none             &none           &msc SCRL_LEFT  &kp INS         &msc SCRL_RIGHT  &none      &none

                                        &none  &none  &none  &none  &none
)

LAYER(Mouse,
    &none  &trans  &trans  &trans  &trans  &trans        &trans  &trans       &mouse_up    &trans        &mkp MB2  &none
    &none  &trans  &trans  &trans  &trans  &trans        &trans  &mouse_left  &mouse_down  &mouse_right  &mkp MB1  &none
    &none  &trans  &trans  &trans  &trans  &trans        &trans  &trans       &trans       &trans        &mkp MB3  &none

                                        &none  &none  &none  &none  &none
)

LAYER(Num,
    &none  &none   &kp N6   &kp N5  &kp N4  &none        &none  &none       &none     &none      &none  &none
    &none  &kp N0  &kp N3   &kp N2  &kp N1  &none        &none  &kp LSHIFT  &kp LGUI  &kp LCTRL  &none  &none
    &none  &none   &kp N9   &kp N8  &kp N7  &none        &none  &kp LALT    &none     &none      &none  &none

                                        &none  &none  &none  &none  &none
)

LAYER(Func,
    &none  &none    &kp F6  &kp F5  &kp F4  &none          &bt BT_CLR    &bt BT_SEL 0  &bt BT_SEL 1  &bt BT_SEL 2  &bootloader  &none
    &none  &kp F10  &kp F3  &kp F2  &kp F1  &kp F11        &out OUT_TOG  &kp LSHFT     &kp LCTRL     &kp LGUI      &sys_reset   &none
    &none  &none    &kp F9  &kp F8  &kp F7  &kp F12        &none         &kp LALT      &none         &none         &none        &none

                                        &none  &none  &none  &none  &none
)
